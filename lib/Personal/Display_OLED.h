#ifndef DISPLAY_OLED_h
#define DISPLAY_OLED_h

#include <SPI.h>
#include <Wire.h>
#include <Adafruit_GFX.h>
#include <Adafruit_SSD1306.h>

#define SCREEN_WIDTH   128 // OLED display width, in pixels
#define SCREEN_HEIGHT  32 // OLED display height, in pixels

#define OLED_RESET     -1 // Reset pin # (or -1 if sharing Arduino reset pin)
#define SCREEN_ADDRESS 0x3C ///< See datasheet for Address; 0x3D for 128x64, 0x3C for 128x32
Adafruit_SSD1306 display(SCREEN_WIDTH, SCREEN_HEIGHT, &Wire, OLED_RESET);

#define LOGO_HEIGHT        13
#define LOGO_WIDTH         17

#define LOGO_HEIGHT2       10
#define LOGO_WIDTH2        37

#define LOGO_HEIGHT3       20
#define LOGO_WIDTH3        20

#define SCREEN_REFRESH     15
#define TEXT_SPEED         2
#define SCREEN_REFRESHAP   20

#define MSG_CLEAN        ""
#define MSG_INIT         " - Sistema Inicializando - "
#define MSG_WIFI_INIT    " - Intentando conexion WiFi - "
#define MSG_WIFI_OK      " - Conexion WiFi Correcta - "
#define MSG_WIFI_FAIL    " - Conexion WiFi Erronea - "
#define MSG_WIFI_AP1     " - Ingresar a la red WiFi: '"
#define MSG_WIFI_AP2     "' y Entrar en pagina web: '"
#define MSG_ALARM        " - Consulta de Listado de Alarmas - "
#define MSG_FAILS        " - Consulta de Listado de Fallas - "
#define MSG_FIREBASE     " - Configuracion de Servidor - "
#define MSG_CAI          " - Conexion con Central Simplex - "
#define MSG_FIREBASE_OK  " - Servidor en Linea - "
#define MSG_CAI_OK       " - Central en Linea - "
#define MSG_FIREBASE_BAD " - Error en Conexion Firebase, Reinicio del Sistema - "


static const unsigned char PROGMEM logo_isolse_bmp[] =
{ // 'Isolse Logo2', 128x32px
0x00, 0x00, 0x00, 0x00, 0x00, 0x00, 0x00, 0x00, 0x00, 0x00, 0x00, 0x00, 0x00, 0x00, 0x00, 0x00,
0x00, 0x00, 0x00, 0x00, 0x00, 0x00, 0x00, 0x00, 0x00, 0x00, 0x00, 0x00, 0x00, 0x00, 0x00, 0x00,
0x00, 0x00, 0x00, 0x00, 0x00, 0x00, 0x00, 0x00, 0x00, 0x00, 0x00, 0x00, 0x0e, 0x00, 0x00, 0x00,
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0x00, 0x00, 0x00, 0x00, 0x00, 0x00, 0x00, 0x00, 0x00, 0x00, 0x00, 0x00, 0x00, 0x00, 0x00, 0x00
};

static const unsigned char PROGMEM logo_bmp[] =
{ // 'Oto logo'
0x03, 0xe0, 0x00, 0x1f, 0xfc, 0x00, 0x7c, 0x1f, 0x00, 0xf0, 0x07, 0x80, 0x47, 0xf1, 0x00, 0x1f,
0x7c, 0x00, 0x38, 0x0c, 0x00, 0x13, 0xe4, 0x00, 0x07, 0xf0, 0x00, 0x06, 0x30, 0x00, 0x00, 0x80,
0x00, 0x01, 0xc0, 0x00, 0x00, 0x80, 0x00  };

static const unsigned char PROGMEM logo1_bmp[] =
{ // '3', 17x13px
0x00, 0x18, 0x00, 0x0f, 0xd8, 0x00, 0x38, 0x1a, 0x00, 0x67, 0xdb, 0x00, 0xde, 0x59, 0x80, 0x39,
0xde, 0x00, 0x27, 0xda, 0x00, 0x0c, 0x18, 0x00, 0x03, 0xd8, 0x00, 0x06, 0x78, 0x00, 0x00, 0x98,
0x00, 0x01, 0xc0, 0x00, 0x00, 0x90, 0x00  };

static const unsigned char PROGMEM logo2_bmp[] =
{ // '3', 17x13px
0x00, 0x00, 0x00, 0x00, 0x00, 0xfd, 0xef, 0xb0, 0x31, 0xf0, 0xfd, 0xef, 0xb0, 0x31, 0xf0, 0x30,
0x0c, 0x30, 0x79, 0xb8, 0x33, 0xef, 0xb0, 0x79, 0xf0, 0x33, 0xef, 0xb0, 0x79, 0xf0, 0x33, 0x81,
0xb0, 0xfd, 0xb8, 0x31, 0xef, 0xbe, 0xfd, 0xf8, 0x31, 0xef, 0x9e, 0xcd, 0xf0, 0x00, 0x00, 0x00,
0x00, 0x00};

static const unsigned char PROGMEM logo3_bmp[] =
{
// 'cc', 20x20px
0x00, 0x00, 0x00, 0x03, 0xfc, 0x00, 0x0e, 0x07, 0x00, 0x18, 0x01, 0x80, 0x30, 0xf0, 0xc0, 0x33,
0xfc, 0x40, 0x66, 0x06, 0x60, 0x44, 0x62, 0x20, 0x4c, 0xf3, 0x20, 0x4d, 0xff, 0xe0, 0x4d, 0xff,
0xe0, 0x4c, 0xf3, 0x20, 0x44, 0x22, 0x20, 0x66, 0x06, 0x60, 0x33, 0xfc, 0x40, 0x30, 0xf0, 0xc0,
0x1c, 0x01, 0x80, 0x0f, 0x07, 0x00, 0x03, 0xfc, 0x00, 0x00, 0x00, 0x00};

#define OFFTIME 650
#define ONTIME  1050

typedef enum
{
  NORMAL,
  FAILURE,
  ALARM,
  BOTH
} Central_State ;

class Screen_Format
{
  private:
  int Msg_pos;
  int Msg_len;
  unsigned long blinky_time;
  bool WiFi_Conn;
  Central_State CAI;
  char message[200];
  public:

  void Screen_Init()
  {
    Msg_pos= display.width();
    Msg_len=0;
    blinky_time = millis();
    WiFi_Conn =false;
    CAI = NORMAL;
    strcpy(message,"");
  }

  void Screen_Refresh(bool WiFi_Con, Central_State CAII, char * messagee )
  {
    Msg_pos= display.width();
    Msg_len =  -6*strlen(messagee);
    #ifdef TEST
      Serial.print("El nuevo largo del mensaje es de: ");
      Serial.println(Msg_len);
    #endif
    WiFi_Conn = WiFi_Con;
    CAI = CAII;
    strcpy(message,messagee);
  }

  void Screen_Loop_Refresh(bool WiFi_Con, Central_State CAII, char * messagee, bool refresh )
  {
    if(refresh)
    {
      Msg_pos= display.width();
      Msg_len =  -6*strlen(messagee);
      #ifdef TEST
        Serial.print("El nuevo largo del mensaje es de: ");
        Serial.println(Msg_len);
      #endif
      strcpy(message,messagee);
    }
    WiFi_Conn = WiFi_Con;
    CAI = CAII;
  }

  void Screen_Set()
  {
    display.clearDisplay();
    if(WiFi_Conn)
    {
      display.drawBitmap(display.width()-LOGO_WIDTH,0,logo_bmp, LOGO_WIDTH, LOGO_HEIGHT, 1);    
    }
    else
    {
      if(millis()-blinky_time>=OFFTIME)
      {
        display.drawBitmap(display.width()-LOGO_WIDTH,0,logo1_bmp, LOGO_WIDTH, LOGO_HEIGHT, 1);  
        if(millis()-blinky_time>=ONTIME)
        {
          blinky_time=millis();
        }
      }
    }
    display.setTextSize(1); // Draw 2X-scale text
    display.setTextColor(SSD1306_BLACK,SSD1306_WHITE);
    display.setCursor(0,14);
    display.print(F("   Central: "));

    switch(CAI)
    {
      case NORMAL:
        display.println(F("Normal   "));
        break;
      case FAIL:
        display.println(F("Falla    "));
        break;
      case ALARM:
        display.println(F("Alarma   "));
        break;
      case BOTH:
        display.println(F("Ala / Fal"));
        break;
      default :  
        display.println(F("---------"));
    }

    display.setTextColor(SSD1306_WHITE);
    display.setCursor(Msg_pos,24);
    display.print(message);
    display.drawBitmap(0,0,logo2_bmp, LOGO_WIDTH2, LOGO_HEIGHT2, 1);
    Msg_pos-=TEXT_SPEED;
    if(Msg_pos<Msg_len)
    {
      Msg_pos=display.width();
    }
    display.display();
  }

  bool get_WiFi()
  {
    return WiFi_Conn;
  }
};

Screen_Format OLED_Display;
unsigned long timey = 0;
unsigned long showtiming;
bool ap_oled=false;

void OLED_show(unsigned int time, char* mssg)
{
  unsigned long timing;
  char msg[10];

  #ifdef TEST
    Serial.print("El mensaje a imprimir en OLED es: ");
    Serial.println(mssg);
  #endif

  timing = millis();
  while(time>(millis()-timing))
  {  
    OLED_Display.Screen_Set();
    delay(SCREEN_REFRESH);
  }
  
  memcpy(msg,MSG_CLEAN,strlen(MSG_CLEAN)+1);
  OLED_Display.Screen_Refresh(OLED_Display.get_WiFi(),NORMAL,msg);  
  OLED_Display.Screen_Set();

}

void OLED_Start()
{
  char mssg[50];
  #ifdef TEST
    unsigned int showtime = 1000;
  #else
    unsigned int showtime = 7000;
  #endif
  if(!display.begin(SSD1306_SWITCHCAPVCC, SCREEN_ADDRESS)) {
    Serial.println(F("SSD1306 allocation failed"));
    for(;;); // Don't proceed, loop forever
  }

  display.clearDisplay();
  display.drawBitmap(0,0,logo_isolse_bmp, 128, 32, 1);
  display.display();
  delay(4000); // Pause for 2 seconds
  
  OLED_Display.Screen_Init();

  memcpy(mssg,MSG_CLEAN,strlen(MSG_CLEAN)+1);
  strcpy(mssg,MSG_INIT);   

  OLED_Display.Screen_Refresh(false,NORMAL,mssg);
  OLED_show(showtime,mssg);
}

void OLED_WiFi()
{
  char mssg[50];
  #ifdef TEST
    unsigned int showtime = 1000;
  #else
    unsigned int showtime = 10000;
  #endif

  memcpy(mssg,MSG_CLEAN,strlen(MSG_CLEAN)+1);
  strcpy(mssg,MSG_WIFI_INIT);   
  OLED_Display.Screen_Refresh(false,NORMAL,mssg);
  
  OLED_show(showtime,mssg);
}

void OLED_Firebase()
{
  char mssg[50];
  #ifdef TEST
    unsigned int showtime = 1000;
  #else
    unsigned int showtime = 15000;
  #endif

  memcpy(mssg,MSG_CLEAN,strlen(MSG_CLEAN)+1);
  strcpy(mssg,MSG_FIREBASE);   
  OLED_Display.Screen_Refresh(true,NORMAL,mssg);

  OLED_show(showtime,mssg);
}

void OLED_Serial()
{
  char mssg[50];
  #ifdef TEST
    unsigned int showtime = 1000;
  #else
    unsigned int showtime = 15000;
  #endif

  memcpy(mssg,MSG_CLEAN,strlen(MSG_CLEAN)+1);
  strcpy(mssg,MSG_CAI);   
  OLED_Display.Screen_Refresh(true,NORMAL,mssg);

  OLED_show(showtime,mssg);
}

void OLED_WiFi_AP(const char * SSID, const char * Hostname)
{
  if(!ap_oled)
  {
    char mssg[150];
  
    memcpy(mssg,MSG_CLEAN,strlen(MSG_CLEAN)+1);
    strcpy(mssg,MSG_WIFI_AP1);
    strcat(mssg,SSID);
    strcat(mssg,MSG_WIFI_AP2);
    strcat(mssg,Hostname);
    strcat(mssg,"' - ");
    OLED_Display.Screen_Refresh(false,NORMAL,mssg);
    ap_oled = true;
    #ifdef TEST
      Serial.print("El mensaje a imprimir en OLED es: ");
      Serial.println(mssg);
    #endif
  }
  else
  { 
    OLED_Display.Screen_Set();
    delay(SCREEN_REFRESHAP);
  } 
}

void OLED_WiFi_State(bool status)
{
  char mssg[50];
  #ifdef TEST
    unsigned int showtime = 1000;
  #else
    unsigned int showtime = 10000;
  #endif
  
  memcpy(mssg,MSG_CLEAN,strlen(MSG_CLEAN)+1);
  if(status)
  {
    strcpy(mssg,MSG_WIFI_OK);
    OLED_Display.Screen_Refresh(true,NORMAL,mssg);
  }
  else
  {
    strcpy(mssg,MSG_WIFI_FAIL);
    OLED_Display.Screen_Refresh(false,NORMAL,mssg);
  }

  showtiming = millis();
  OLED_show(showtime,mssg);
}

void OLED_Firebase_OK()
{
  char mssg[50];
  #ifdef TEST
    unsigned int showtime = 1000;
  #else
    unsigned int showtime = 10000;
  #endif

  memcpy(mssg,MSG_CLEAN,strlen(MSG_CLEAN)+1);
  strcpy(mssg,MSG_FIREBASE_OK);   
  OLED_Display.Screen_Refresh(true,NORMAL,mssg);

  OLED_show(showtime,mssg);
}

void OLED_CAI_OK()
{
  char mssg[50];
  #ifdef TEST
    unsigned int showtime = 1000;
  #else
    unsigned int showtime = 10000;
  #endif

  memcpy(mssg,MSG_CLEAN,strlen(MSG_CLEAN)+1);
  strcpy(mssg,MSG_CAI_OK);   
  OLED_Display.Screen_Refresh(true,NORMAL,mssg);

  OLED_show(showtime,mssg);
}

void OLED_Firebase_BAD()
{
  char mssg[60];
  unsigned int showtime = 10000;

  memcpy(mssg,MSG_CLEAN,strlen(MSG_CLEAN)+1);
  strcpy(mssg,MSG_FIREBASE_BAD);   
  OLED_Display.Screen_Refresh(false,NORMAL,mssg);

  OLED_show(showtime,mssg);

}

#endif